## rpi-build/conf/bblayers.conf
```bitbake
# POKY_BBLAYERS_CONF_VERSION is increased each time build/conf/bblayers.conf
# changes incompatibly
POKY_BBLAYERS_CONF_VERSION = "2"

BBPATH = "${TOPDIR}"
BBFILES ?= ""

BBLAYERS ?= " \
  /home/chrisn/data/raid0/Software/poky/meta \
  /home/chrisn/data/raid0/Software/poky/meta-poky \
  /home/chrisn/data/raid0/Software/poky/meta-yocto-bsp \
  /home/chrisn/data/raid0/Software/meta-openembedded/meta-oe \
  /home/chrisn/data/raid0/Software/meta-openembedded/meta-python \
  /home/chrisn/data/raid0/Software/meta-openembedded/meta-networking \
  /home/chrisn/data/raid0/Software/meta-raspberrypi \
  /home/chrisn/data/raid0/Software/poky/meta-rpi-custom \
  "
```
